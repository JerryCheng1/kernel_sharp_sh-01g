## drivers/sharp/shgrip/Kconfig
```kconfig
#
# SHARP Grip Sensor Driver configuration
#

menu "Grip Sensor Driver configuration"

config SENSOR_SHGRIP
        bool "SHARP Grip Sensor Driver"
        default n

config SENSOR_SHGRIP_MODEL1
        bool "SHARP Grip Sensor Model1 Driver"
        depends on SENSOR_SHGRIP
        default n

config SENSOR_SHGRIP_MODEL2
        bool "SHARP Grip Sensor Model2 Driver"
        depends on SENSOR_SHGRIP
        default n

config SENSOR_SHGRIP_MODEL3
        bool "SHARP Grip Sensor Model3 Driver"
        depends on SENSOR_SHGRIP
        default n
endmenu
```

## drivers/sharp/shtps/Kconfig
```kconfig
#
# Sharp Touchscreen configuration
#

menu "SHTPS driver"

comment "SHARP Touchscreen device drivers"

config TOUCHSCREEN_SHTPS
	bool "SHARP Touchscreens"
	default n

if TOUCHSCREEN_SHTPS
	config SHTPS_SY3X00_DEV
		tristate "SY3x00 Device"
		default n
		depends on TOUCHSCREEN_SHTPS

	config SHTPS_SY3000_TM2945_001
		tristate "SY3000 TM2945-001"
		default n
		depends on SHTPS_SY3X00_DEV

	config SHTPS_SY3000_TM2979_001
		tristate "SY3000 TM2979-001"
		default n
		depends on SHTPS_SY3X00_DEV

	config SHTPS_SY3000_TM3058_001
		tristate "SY3000 TM3058-001"
		default n
		depends on SHTPS_SY3X00_DEV

endif # TOUCHSCREEN_SHTPS

endmenu
```
